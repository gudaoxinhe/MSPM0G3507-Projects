/**
 * @cliArgs --device "MSPM0G350X" --part "Default" --package "LQFP-64(PM)" --product "mspm0_sdk@2.05.00.05"
 * @versions {"tool":"1.24.0+4150"}
 */

/**
 * Import the modules used in this configuration.
 */
const GPIO   = scripting.addModule("/ti/driverlib/GPIO", {}, false);
const GPIO1  = GPIO.addInstance();
const SYSCTL = scripting.addModule("/ti/driverlib/SYSCTL");

/**
 * Write custom configuration values to the imported modules.
 */
GPIO1.$name                          = "GPIO_Encoder";
GPIO1.associatedPins.create(8);
GPIO1.associatedPins[0].$name        = "PIN_Front_Left_A";
GPIO1.associatedPins[0].direction    = "INPUT";
GPIO1.associatedPins[0].interruptEn  = true;
GPIO1.associatedPins[0].polarity     = "RISE";
GPIO1.associatedPins[0].assignedPort = "PORTB";
GPIO1.associatedPins[0].assignedPin  = "18";
GPIO1.associatedPins[1].$name        = "PIN_Front_Left_B";
GPIO1.associatedPins[1].direction    = "INPUT";
GPIO1.associatedPins[1].assignedPort = "PORTA";
GPIO1.associatedPins[1].assignedPin  = "17";
GPIO1.associatedPins[1].polarity     = "RISE";
GPIO1.associatedPins[2].$name        = "PIN_Front_Right_A";
GPIO1.associatedPins[2].direction    = "INPUT";
GPIO1.associatedPins[2].assignedPort = "PORTA";
GPIO1.associatedPins[2].assignedPin  = "16";
GPIO1.associatedPins[2].interruptEn  = true;
GPIO1.associatedPins[2].polarity     = "RISE";
GPIO1.associatedPins[3].$name        = "PIN_Front_Right_B";
GPIO1.associatedPins[3].direction    = "INPUT";
GPIO1.associatedPins[3].assignedPort = "PORTA";
GPIO1.associatedPins[3].assignedPin  = "15";
GPIO1.associatedPins[4].$name        = "PIN_Back_Left_A";
GPIO1.associatedPins[4].direction    = "INPUT";
GPIO1.associatedPins[4].assignedPort = "PORTB";
GPIO1.associatedPins[4].assignedPin  = "19";
GPIO1.associatedPins[4].interruptEn  = true;
GPIO1.associatedPins[4].polarity     = "RISE";
GPIO1.associatedPins[5].$name        = "PIN_Back_Left_B";
GPIO1.associatedPins[5].direction    = "INPUT";
GPIO1.associatedPins[5].assignedPort = "PORTA";
GPIO1.associatedPins[5].assignedPin  = "22";
GPIO1.associatedPins[6].$name        = "PIN_Back_Right_A";
GPIO1.associatedPins[6].direction    = "INPUT";
GPIO1.associatedPins[6].interruptEn  = true;
GPIO1.associatedPins[6].polarity     = "RISE";
GPIO1.associatedPins[6].assignedPin  = "24";
GPIO1.associatedPins[6].assignedPort = "PORTA";
GPIO1.associatedPins[7].$name        = "PIN_Back_Right_B";
GPIO1.associatedPins[7].direction    = "INPUT";
GPIO1.associatedPins[7].assignedPort = "PORTA";
GPIO1.associatedPins[7].assignedPin  = "18";

const Board = scripting.addModule("/ti/driverlib/Board", {}, false);

SYSCTL.forceDefaultClkConfig = true;

/**
 * Pinmux solution for unlocked pins/peripherals. This ensures that minor changes to the automatic solver in a future
 * version of the tool will not impact the pinmux you originally saw.  These lines can be completely deleted in order to
 * re-solve from scratch.
 */
GPIO1.associatedPins[0].pin.$suggestSolution = "PB18";
GPIO1.associatedPins[1].pin.$suggestSolution = "PA17";
GPIO1.associatedPins[2].pin.$suggestSolution = "PA16";
GPIO1.associatedPins[3].pin.$suggestSolution = "PA15";
GPIO1.associatedPins[4].pin.$suggestSolution = "PB19";
GPIO1.associatedPins[5].pin.$suggestSolution = "PA22";
GPIO1.associatedPins[6].pin.$suggestSolution = "PA24";
GPIO1.associatedPins[7].pin.$suggestSolution = "PA18";
Board.peripheral.$suggestSolution            = "DEBUGSS";
Board.peripheral.swclkPin.$suggestSolution   = "PA20";
Board.peripheral.swdioPin.$suggestSolution   = "PA19";
SYSCTL.peripheral.$suggestSolution           = "SYSCTL";
